/* Copyright (c) 2014-2015, The Linux Foundation. All rights reserved.
 *
 * This program is free software; you can redistribute it and/or modify
 * it under the terms of the GNU General Public License version 2 and
 * only version 2 as published by the Free Software Foundation.
 *
 * This program is distributed in the hope that it will be useful,
 * but WITHOUT ANY WARRANTY; without even the implied warranty of
 * MERCHANTABILITY or FITNESS FOR A PARTICULAR PURPOSE.  See the
 * GNU General Public License for more details.
 */

&mdss_mdp {
	dsi_hx8379a_fwvga_truly_vid: qcom,mdss_dsi_hx8379a_fwvga_truly_vid {
		qcom,mdss-dsi-panel-name = "HX8379A fwvga video mode dsi panel";
		qcom,mdss-dsi-panel-type = "dsi_video_mode";
		qcom,mdss-dsi-panel-destination = "display_1";
		qcom,mdss-dsi-panel-mode-gpio-state = "high";
		qcom,mdss-dsi-panel-framerate = <60>;
		qcom,mdss-dsi-virtual-channel-id = <0>;
		qcom,mdss-dsi-stream = <0>;
		qcom,mdss-dsi-panel-width = <480>;
		qcom,mdss-dsi-panel-height = <864>;
		qcom,mdss-dsi-h-front-porch = <46>;
		qcom,mdss-dsi-h-back-porch = <44>;
		qcom,mdss-dsi-h-pulse-width = <4>;
		qcom,mdss-dsi-h-sync-skew = <0>;
		qcom,mdss-dsi-v-back-porch = <16>;
		qcom,mdss-dsi-v-front-porch = <15>;
		qcom,mdss-dsi-v-pulse-width = <1>;
		qcom,mdss-dsi-h-left-border = <0>;
		qcom,mdss-dsi-h-right-border = <0>;
		qcom,mdss-dsi-v-top-border = <0>;
		qcom,mdss-dsi-v-bottom-border = <0>;
		qcom,mdss-dsi-bpp = <24>;
		qcom,mdss-dsi-color-order = "rgb_swap_rgb";
		qcom,mdss-dsi-underflow-color = <0xff>;
		qcom,mdss-dsi-border-color = <0>;

		qcom,mdss-dsi-on-command = [	29 01 00 00 00 00 04 FF 80 09 01
						23 01 00 00 00 00 02 00 80
						29 01 00 00 00 00 03 FF 80 09
						23 01 00 00 00 00 02 00 00
						23 01 00 00 00 00 02 D8 87
						23 01 00 00 00 00 02 00 01
						23 01 00 00 00 00 02 D8 87
						23 01 00 00 00 00 02 00 B1
						23 01 00 00 00 00 02 C5 A9
						23 01 00 00 00 00 02 00 91
						23 01 00 00 00 00 02 C5 79
						23 01 00 00 00 00 02 00 00
						23 01 00 00 00 00 02 D9 45
						23 01 00 00 00 00 02 00 92
						23 01 00 00 00 00 02 C5 01
						23 01 00 00 00 00 02 00 A1
						23 01 00 00 00 00 02 C1 08
						23 01 00 00 00 00 02 00 81
						23 01 00 00 00 00 02 C1 66
						23 01 00 00 00 00 02 00 a3
						23 01 00 00 00 00 02 c0 1B
						23 01 00 00 00 00 02 00 82
						23 01 00 00 00 00 02 c5 83
						23 01 00 00 00 00 02 00 81
						23 01 00 00 00 00 02 c4 83
						23 01 00 00 00 00 02 00 90
						23 01 00 00 00 00 02 B3 02
						23 01 00 00 00 00 02 00 92
						23 01 00 00 00 00 02 B3 45
						23 01 00 00 00 00 02 00 a0
						23 01 00 00 00 00 02 c1 ea
						23 01 00 00 00 00 02 00 c0
						23 01 00 00 00 00 02 c5 00
						23 01 00 00 00 00 02 00 8b
						23 01 00 00 00 00 02 b0 40
						23 01 00 00 00 00 02 00 87
						29 01 00 00 00 00 04 C4 00 80 00
						23 01 00 00 00 00 02 00 B2
						29 01 00 00 00 00 05 F5 15 00 15 00
						23 01 00 00 00 00 02 00 93
						23 01 00 00 00 00 02 C5 03
						23 01 00 00 00 00 02 00 a7
						23 01 00 00 00 00 02 b3 01
						23 01 00 00 00 00 02 00 a6
						23 01 00 00 00 00 02 b3 2b
						23 01 00 00 00 00 02 00 90
						29 01 00 00 00 00 07 C0 00 4E 00 00 00 03
						23 01 00 00 00 00 02 00 a6
						29 01 00 00 00 00 04 C1 01 00 00
						23 01 00 00 00 00 02 00 00
						29 01 00 00 00 00 11 E1 05 0B 0F 0F 08 0D 0C 0B 02 06 16 12 18 24 17 00
						23 01 00 00 00 00 02 00 00
						29 01 00 00 00 00 11 E2 05 0B 0F 0F 08 0D 0C 0B 02 06 16 12 18 24 17 00
						23 01 00 00 00 00 02 00 91
						23 01 00 00 00 00 02 B3 00
						23 01 00 00 00 00 02 00 80
						29 01 00 00 00 00 0d CE 85 01 18 84 01 18 00 00 00 00 00 00
						23 01 00 00 00 00 02 00 90
						29 01 00 00 00 00 0f CE 13 56 18 13 57 18 00 00 00 00 00 00 00 00
						23 01 00 00 00 00 02 00 a0
						29 01 00 00 00 00 0f CE 18 0B 03 5E 00 18 00 18 0A 03 5F 00 18 00
						23 01 00 00 00 00 02 00 b0
						29 01 00 00 00 00 0f CE 18 0D 03 5C 00 18 00 18 0C 03 5D 00 18 00
						23 01 00 00 00 00 02 00 c0
						29 01 00 00 00 00 0f CE 38 0D 03 5E 00 10 07 38 0C 03 5F 00 10 07
						23 01 00 00 00 00 02 00 d0
						29 01 00 00 00 00 0f CE 38 09 03 5A 00 10 07 38 08 03 5B 00 10 07
						23 01 00 00 00 00 02 00 C7
						23 01 00 00 00 00 02 CF 04
						23 01 00 00 00 00 02 00 C9
						23 01 00 00 00 00 02 CF 00
						23 01 00 00 00 00 02 00 C0
						23 01 00 00 00 00 02 CB 14
						23 01 00 00 00 00 02 00 C2
						23 01 00 00 00 00 06 CB 14 14 14 14 14
						23 01 00 00 00 00 02 00 D5
						23 01 00 00 00 00 02 CB 14
						23 01 00 00 00 00 02 00 D7
						29 01 00 00 00 00 06 CB 14 14 14 14 14
						23 01 00 00 00 00 02 00 80
						23 01 00 00 00 00 02 CC 01
						23 01 00 00 00 00 02 00 82
						29 01 00 00 00 00 06 CC 0F 0D 0B 09 05
						23 01 00 00 00 00 02 00 9A
						23 01 00 00 00 00 02 CC 02
						23 01 00 00 00 00 02 00 9C
						29 01 00 00 00 00 04 CC 10 0E 0C
						23 01 00 00 00 00 02 00 A0
						23 01 00 00 00 00 02 CC 0A
						23 01 00 00 00 00 02 00 A1
						23 01 00 00 00 00 02 CC 06
						23 01 00 00 00 00 02 00 B0
						23 01 00 00 00 00 02 CC 01
						23 01 00 00 00 00 02 00 B2
						29 01 00 00 00 00 06 CC 0F 0D 0B 09 05
						23 01 00 00 00 00 02 00 CA
						23 01 00 00 00 00 02 CC 02
						23 01 00 00 00 00 02 00 CC
						29 01 00 00 00 00 04 CC 10 0E 0C
						23 01 00 00 00 00 02 00 D0
						23 01 00 00 00 00 02 CC 0A
						23 01 00 00 00 00 02 00 D1
						23 01 00 00 00 00 02 CC 06
						05 01 00 00 00 00 01 11
                        05 01 00 00 00 00 01 29
					];





		qcom,mdss-dsi-off-command = [05 01 00 00 78 00 02 28 00
					     05 01 00 00 78 00 02 10 00
					];
		qcom,mdss-dsi-on-command-state = "dsi_lp_mode";
		qcom,mdss-dsi-off-command-state = "dsi_lp_mode";
		qcom,mdss-dsi-h-sync-pulse = <0>;
		qcom,mdss-dsi-traffic-mode = "non_burst_sync_event";
		qcom,mdss-dsi-bllp-eof-power-mode;
		qcom,mdss-dsi-bllp-power-mode;
		qcom,mdss-dsi-lane-0-state;
		qcom,mdss-dsi-lane-1-state;
		qcom,mdss-dsi-panel-timings = [67 16 0e 00 33 38 12 19 18 03 04 a0];
		qcom,mdss-dsi-t-clk-post = <0x04>;
		qcom,mdss-dsi-t-clk-pre = <0x1c>;
		qcom,mdss-dsi-bl-min-level = <1>;
		qcom,mdss-dsi-bl-max-level = <255>;
		qcom,mdss-dsi-bl-pmic-pwm-frequency = <100>;
		qcom,mdss-dsi-bl-pmic-bank-select = <7>;
		qcom,mdss-dsi-mdp-trigger = "none";
		qcom,mdss-dsi-bl-pmic-control-type = "bl_ctrl_pwm";
		qcom,mdss-dsi-reset-sequence = <1 20>, <0 10>, <1 20>;
		qcom,mdss-pan-physical-width-dimension = <52>;
		qcom,mdss-pan-physical-height-dimension = <86>;
		qcom,mdss-dsi-te-pin-select = <1>;
		qcom,mdss-dsi-te-check-enable;
		qcom,mdss-dsi-te-using-te-pin;

	};
};
